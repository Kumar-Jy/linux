## Documentation/devicetree/bindings/power/supply/idt,p9418.yaml
```yaml
# SPDX-License-Identifier: GPL-2.0
%YAML 1.2
---
$id: http://devicetree.org/schemas/power/supply/idt,p9418.yaml#
$schema: http://devicetree.org/meta-schemas/core.yaml#

title: IDT P9418 Wireless Power Charger

maintainers:
  - Viola Guerrera <viooo@anche.no>

properties:
  compatible:
    const: idt,p9418

  reg:
    maxItems: 1
    description: I2C address of the device

  idt,irq-gpios:
    maxItems: 1
    description: |
      GPIO used as the interrupt line from the chip to the host.

  idt,hall3-gpios:
    maxItems: 1
    description: |
      GPIO used to detect pen presence (active high).

  idt,hall4-gpios:
    maxItems: 1
    description: |
      GPIO used to detect pen presence (active low).

  idt,reverse-enable-gpios:
    maxItems: 1
    description: |
      GPIO used to enable or disable the wireless power transmitter chip.

  idt,reverse-boost-enable-gpios:
    maxItems: 1
    description: |
      GPIO used to enable the boost converter for reverse charging.

  '#address-cells':
    const: 1

  '#size-cells':
    const: 0

required:
  - compatible
  - reg
  - idt,reverse-enable-gpios
  - idt,reverse-boost-enable-gpios

additionalProperties: false

examples:
  - |
    #include <dt-bindings/gpio/gpio.h>

    i2c17: i2c@17 {
        status = "okay";

        idtp9418: idtp9418@3b {
            compatible = "idt,p9418";
            reg = <0x3b>;
            status = "okay";
            idt,irq-gpios = <&tlmm 95 GPIO_ACTIVE_HIGH>;
            idt,hall3-gpios = <&tlmm 101 GPIO_ACTIVE_HIGH>;
            idt,hall4-gpios = <&tlmm 134 GPIO_ACTIVE_HIGH>;
            idt,reverse-enable-gpios = <&tlmm 3 GPIO_ACTIVE_HIGH>;
            idt,reverse-boost-enable-gpios = <&tlmm 47 GPIO_ACTIVE_HIGH>;
        };
    };
...
```

## drivers/hid/hid-xiaomi/Kconfig
```kconfig
config HID_XIAOMI
	tristate "Xiaomi HID support"
	help
	  Generic HID driver for Xiaomi devices.

config XIAOMI_KEYBOARD
	tristate "Xiaomi Keyboard (HID)"
	select HID_XIAOMI
	default m
	help
	  Xiaomi keyboard HID driver.

config XIAOMI_MOUSE
	tristate "Xiaomi Mouse (HID)"
	select HID_XIAOMI
	default m
	help
	  Xiaomi mouse HID driver.
```
