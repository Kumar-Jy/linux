## Documentation/devicetree/bindings/power/supply/lionsemi,ln8000.yaml
```yaml
# SPDX-License-Identifier: (GPL-2.0-only OR BSD-2-Clause)
%YAML 1.2
---
$id: http://devicetree.org/schemas/power/supply/lionsemi,ln8000.yaml#
$schema: http://devicetree.org/meta-schemas/core.yaml#

title: LION Semiconductor LN8000 Switched-Capacitor Direct Charger

maintainers:
  - map220v <map220v300@gmail.com>

description: |
  The LN8000 is a 2:1 switched-capacitor charger that converts a
  high-voltage input (negotiated over USB-PD, up to ~13V) to the battery
  voltage at roughly double the current. It is used as a parallel direct-charge
  path that offloads the PMIC's integrated USBIN charger for high-power
  (33W-class) charging.

allOf:
  - $ref: power-supply.yaml#

properties:
  compatible:
    const: lionsemi,ln8000

  reg:
    maxItems: 1

  interrupts:
    maxItems: 1
    description: |
      Interrupt from the LN8000 INT pin. Asserted on fault, watchdog,
      mode-change and ADC-done events.

  lionsemi,bat-ovp-threshold-microvolt:
    description: Battery over-voltage protection threshold.
    default: 4440000
    minimum: 3725000
    maximum: 5000000

  lionsemi,bus-ovp-threshold-microvolt:
    description: Input (bus) over-voltage protection threshold.
    default: 9500000

  lionsemi,bus-ocp-threshold-microamp:
    description: Input (bus) over-current protection threshold.
    default: 2000000

  lionsemi,ntc-alarm-cfg:
    $ref: /schemas/types.yaml#/definitions/uint32
    description: NTC alarm threshold configuration code (0..1023).
    default: 226

  lionsemi,vbat-ovp-disable:
    type: boolean
    description: Disable battery over-voltage protection.

  lionsemi,vbat-reg-disable:
    type: boolean
    description: Disable battery float-voltage regulation loop.

  lionsemi,iin-ocp-disable:
    type: boolean
    description: Disable input over-current protection.

  lionsemi,iin-reg-disable:
    type: boolean
    description: Disable input current regulation loop.

  lionsemi,tbus-mon-disable:
    type: boolean
    description: Disable bus (TSBUS) temperature monitoring.

  lionsemi,tbat-mon-disable:
    type: boolean
    description: Disable battery (TSBAT) temperature monitoring.

required:
  - compatible
  - reg

unevaluatedProperties: false

examples:
  - |
    i2c {
        #address-cells = <1>;
        #size-cells = <0>;

        charger@51 {
            compatible = "lionsemi,ln8000";
            reg = <0x51>;
            interrupt-parent = <&tlmm>;
            interrupts = <55 IRQ_TYPE_LEVEL_LOW>;

            lionsemi,bat-ovp-threshold-microvolt = <4560000>;
            lionsemi,bus-ovp-threshold-microvolt = <13000000>;
            lionsemi,bus-ocp-threshold-microamp = <3750000>;
            lionsemi,ntc-alarm-cfg = <226>;

            lionsemi,tbus-mon-disable;
            lionsemi,tbat-mon-disable;
            lionsemi,iin-ocp-disable;
            lionsemi,iin-reg-disable;
            lionsemi,vbat-reg-disable;
        };
    };
```

## Documentation/devicetree/bindings/power/supply/maxim,ds28e16-xiaomi.yaml
```yaml
# SPDX-License-Identifier: (GPL-2.0-only OR BSD-2-Clause)
%YAML 1.2
---
$id: http://devicetree.org/schemas/power/supply/maxim,ds28e16-xiaomi.yaml#
$schema: http://devicetree.org/meta-schemas/core.yaml#

title: Maxim DS28E16 battery authenticator on Xiaomi devices

maintainers:
  - TwinbornPlate75 <3342733415@qq.com>

description: |
  The DS28E16 is a 1-Wire secure authenticator used by Xiaomi to authenticate
  battery packs before enabling high-current and switched-capacitor charging.
  Xiaomi nabu contains one authenticator for each half of its dual battery.

  The downstream implementation accesses Qualcomm TLMM direction and data
  registers directly because generic GPIO operations do not provide stable
  enough sub-microsecond timing.  The GPIO is nevertheless requested through
  gpiolib for ownership and pinctrl configuration.

properties:
  compatible:
    const: maxim,ds28e16-xiaomi

  gpios:
    maxItems: 1
    description: 1-Wire data GPIO.

  maxim,auth-role:
    $ref: /schemas/types.yaml#/definitions/string
    enum: [ primary, secondary ]
    description: Identifies which battery-half authenticator this node owns.

  maxim,gpio-config-address:
    $ref: /schemas/types.yaml#/definitions/uint32
    description: Physical address of the Qualcomm TLMM GPIO configuration register.

  maxim,gpio-io-offset:
    $ref: /schemas/types.yaml#/definitions/uint32
    minimum: 4
    maximum: 4096
    description: Offset from the configuration register to the GPIO input/output register.

  pinctrl-names:
    items:
      - const: default

  pinctrl-0: true

required:
  - compatible
  - gpios
  - maxim,auth-role
  - maxim,gpio-config-address
  - maxim,gpio-io-offset
  - pinctrl-names
  - pinctrl-0

additionalProperties: false

examples:
  - |
    battery-auth-primary {
        compatible = "maxim,ds28e16-xiaomi";
        gpios = <&tlmm 5 0>;
        maxim,auth-role = "primary";
        maxim,gpio-config-address = <0x03d05000>;
        maxim,gpio-io-offset = <4>;
        pinctrl-names = "default";
        pinctrl-0 = <&ds28e16_primary_default>;
    };
```

## Documentation/devicetree/bindings/power/supply/qcom,pm8150b-bms.yaml
```yaml
# SPDX-License-Identifier: (GPL-2.0-only OR BSD-2-Clause)
%YAML 1.2
---
$id: http://devicetree.org/schemas/power/supply/qcom,pm8150b-bms.yaml#
$schema: http://devicetree.org/meta-schemas/core.yaml#

title: Qualcomm Unified Battery/Charger Manager

maintainers:
  - TwinbornPlate75 <3342733415@qq.com>

description: |
  The Qualcomm unified battery/charger manager is a virtual coordinator
  that aggregates the Qualcomm fuel gauge, PMIC charger, and optional
  direct chargers into user-facing qcom-battery and qcom-usb power
  supplies.  It does not own any hardware registers itself; the actual
  battery, charger and direct-charge devices are described by their own
  DT nodes and registered with the coordinator at runtime.

allOf:
  - $ref: power-supply.yaml#

properties:
  compatible:
    const: qcom,pm8150b-bms

  qcom,required-authenticators:
    $ref: /schemas/types.yaml#/definitions/uint32
    minimum: 0
    maximum: 3
    default: 0
    description: |
      Bit mask of battery authenticators which must pass before high-current
      charging is allowed. Bit 0 is primary and bit 1 is secondary.

  status:
    description: Standard device status property.

required:
  - compatible

additionalProperties: false

examples:
  - |
    battery-manager {
        compatible = "qcom,pm8150b-bms";
        qcom,required-authenticators = <3>;
        status = "okay";
    };
```

## drivers/power/supply/qcom_bms/Kconfig
```kconfig
# SPDX-License-Identifier: GPL-2.0-only
#
# Qualcomm power supply drivers
#

config QCOM_BMS
	tristate "Qualcomm unified battery/charger manager"
	depends on OF
	depends on MFD_SPMI_PMIC
	depends on IIO
	depends on POWER_SUPPLY
	help
	  Aggregates the Qualcomm fuel gauge, PMIC charger, and direct
	  chargers into the unified qcom-bms / qcom-bms-usb power supplies.

config QCOM_BMS_LN8000
	tristate "LION Semiconductor LN8000 direct charger"
	depends on QCOM_BMS
	depends on I2C
	select REGMAP_I2C
	help
	  Enable support for the LN8000 switched-capacitor direct charger.

	  If unsure, say N.

config QCOM_BMS_DS28E16
	tristate "Maxim DS28E16 Xiaomi battery authentication"
	depends on QCOM_BMS
	depends on GPIOLIB
	select CRYPTO_HMAC
	select CRYPTO_SHA3
	select CRC8
	select CRC16
	help
	  Maxim DS28E16 1-Wire authenticators.
```
